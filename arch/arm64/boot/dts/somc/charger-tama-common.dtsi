// SPDX-License-Identifier: GPL-2.0-only
/*
 * Copyright (c) 2015-2017, The Linux Foundation. All rights reserved.
 */

&pmi8998_charger {
	qcom,usb-icl-ua = <1500000>;
	somc,jeita-sw-ctrl-en;
	io-channels = <&pmi8998_rradc 2>,
		      <&pmi8998_rradc 3>,
		      <&pmi8998_rradc 4>,
		      <&pmi8998_rradc 5>,
		      <&pmi8998_rradc 6>,
		      <&pmi8998_rradc 8>,
		      <&pmi8998_rradc 10>,
		      <&pmi8998_fg PSY_IIO_DEBUG_BATTERY>,
		      <&pmi8998_fg PSY_IIO_CAPACITY>,
		      <&pmi8998_fg PSY_IIO_VOLTAGE_NOW>,
		      <&pmi8998_fg PSY_IIO_CURRENT_NOW>,
		      <&pmi8998_fg PSY_IIO_CHARGE_FULL>,
		      <&pmi8998_fg PSY_IIO_CHARGE_COUNTER>,
		      <&pmi8998_fg PSY_IIO_CYCLE_COUNT>,
		      <&pmi8998_fg PSY_IIO_CHARGE_FULL_DESIGN>,
		      <&pmi8998_fg PSY_IIO_TIME_TO_FULL_NOW>,
		      <&pmi8998_fg PSY_IIO_TEMP>,
			  <&pmi8998_fg PSY_IIO_SOMC_MONOTONIC_SOC>;
	io-channel-names = "skin_temp",
			   "usbin_i",
			   "usbin_v",
			   "dcin_i",
			   "dcin_v",
			   "charger_temp",
			   "charger_temp_max",
			   "debug_battery",
			   "capacity",
			   "voltage_now",
			   "current_now",
			   "charge_full",
			   "charge_counter",
			   "cycle_count",
			   "charge_full_design",
			   "time_to_full_now",
			   "temp",
			   "somc_monotonic_soc";
	/delete-property/ qcom,auto-recharge-soc;
};

&pmi8998_rradc {
	somc,reg-cfg =
	/* addr mask value */
		<0x83 0x07 0x04>, /* FG_ADC_RR_AUX_THERM_CFG */
		<0x88 0xFF 0xAF>, /* FG_ADC_RR_AUX_THERM_C1 */
		<0x89 0xFF 0x34>, /* FG_ADC_RR_AUX_THERM_C2 */
		<0x8A 0xFF 0xDF>, /* FG_ADC_RR_AUX_THERM_C3 */
		<0x8B 0xFF 0xA0>; /* FG_ADC_RR_AUX_THERM_HALF_RANGE */
};

&pmi8998_fg {
	qcom,fg-delta-soc-thr = <1>;
	/delete-property/ qcom,fg-auto-recharge-soc;
	qcom,fg-recharge-soc-thr = <95>;
	qcom,fg-empty-voltage = <3100>;
	qcom,fg-rsense-sel = <0>;
	qcom,fg-jeita-thresholds = <5 10 45 55>;
	qcom,fg-esr-pulse-thresh-ma = <110>;
	qcom,slope-limit-temp-threshold = <100>;
	qcom,slope-limit-coeffs = <1 1 1 1>;
	qcom,fg-esr-tight-lt-filter-micro-pct = <30000>;
	qcom,fg-esr-broad-lt-filter-micro-pct = <30000>;
	qcom,cycle-counter-en;
	qcom,cl-start-capacity = <15>;
	qcom,cl-min-temp = <150>;
	qcom,cl-max-temp = <450>;
	qcom,fg-jeita-hyst-temp = <2>;
	qcom,hold-soc-while-full;
	qcom,cl-max-increment = <0>;
	qcom,cl-max-decrement = <20>;
	qcom,battery-thermal-coefficients = [c7 50 ff];
};

&pmi8998_pdphy {
	qcom,default-sink-caps = <5000 500>; /* 5V @ 500mA */
};
